## buildroot-external/Config.in
```kconfig
menu "Pi 4B minimal packages"

source "$BR2_EXTERNAL_PI4MINIMAL_PATH/package/ncnn/Config.in"

endmenu
```

## buildroot-external/configs/pi4_minimal_defconfig
```kconfig
BR2_aarch64=y
BR2_cortex_a72=y
BR2_TOOLCHAIN_BUILDROOT_MUSL=y
BR2_TOOLCHAIN_BUILDROOT_CXX=y
BR2_GCC_VERSION_13_X=y
# Use the pinned Raspberry Pi release tarball for both kernel and headers.
BR2_KERNEL_HEADERS_AS_KERNEL=y
BR2_GLOBAL_PATCH_DIR="$(BR2_EXTERNAL_PI4MINIMAL_PATH)/patches"
BR2_TARGET_GENERIC_HOSTNAME="pi4-minimal"
BR2_TARGET_GENERIC_ISSUE="Pi 4B minimal inference appliance\\n"
BR2_TARGET_GENERIC_ROOT_PASSWD="pi4root"
BR2_ROOTFS_DEVICE_CREATION_DYNAMIC_DEVTMPFS=y
BR2_TARGET_GENERIC_REMOUNT_ROOTFS_RW=y
BR2_SYSTEM_DHCP="eth0"
BR2_ROOTFS_OVERLAY="$(BR2_EXTERNAL_PI4MINIMAL_PATH)/board/pi4/rootfs-overlay"
BR2_ROOTFS_POST_BUILD_SCRIPT="$(BR2_EXTERNAL_PI4MINIMAL_PATH)/board/pi4/post-build.sh"
BR2_ROOTFS_POST_IMAGE_SCRIPT="$(BR2_EXTERNAL_PI4MINIMAL_PATH)/board/pi4/post-image.sh"
BR2_LINUX_KERNEL=y
BR2_LINUX_KERNEL_CUSTOM_TARBALL=y
BR2_LINUX_KERNEL_CUSTOM_TARBALL_LOCATION="https://github.com/raspberrypi/linux/archive/refs/tags/stable_20260724.tar.gz"
BR2_LINUX_KERNEL_USE_CUSTOM_CONFIG=y
BR2_LINUX_KERNEL_CUSTOM_CONFIG_FILE="$(BR2_EXTERNAL_PI4MINIMAL_PATH)/board/pi4/linux.config"
BR2_LINUX_KERNEL_DTS_SUPPORT=y
BR2_LINUX_KERNEL_INTREE_DTS_NAME="broadcom/bcm2711-rpi-4-b"
BR2_LINUX_KERNEL_NEEDS_HOST_OPENSSL=y
BR2_PACKAGE_BUSYBOX=y
BR2_PACKAGE_DROPBEAR=y
BR2_PACKAGE_WPA_SUPPLICANT=y
BR2_PACKAGE_WPA_SUPPLICANT_CLI=y
BR2_PACKAGE_LINUX_FIRMWARE=y
BR2_PACKAGE_LINUX_FIRMWARE_BRCM_BCM43XXX=y
BR2_PACKAGE_LIBV4L=y
BR2_PACKAGE_LIBV4L_UTILS=y
BR2_PACKAGE_NCNN=y
BR2_TARGET_ROOTFS_EXT2=y
BR2_TARGET_ROOTFS_EXT2_4=y
BR2_TARGET_ROOTFS_EXT2_SIZE="256M"
BR2_TARGET_ROOTFS_TAR=y
BR2_TARGET_ROOTFS_CPIO=y
BR2_TARGET_ROOTFS_CPIO_GZIP=y
BR2_TARGET_ROOTFS_CPIO_PADV2=y
BR2_PACKAGE_RPI_FIRMWARE=y
BR2_PACKAGE_RPI_FIRMWARE_VARIANT_PI4=y
BR2_PACKAGE_RPI_FIRMWARE_CONFIG_FILE="$(BR2_EXTERNAL_PI4MINIMAL_PATH)/board/pi4/config.txt"
BR2_PACKAGE_HOST_DOSFSTOOLS=y
BR2_PACKAGE_HOST_GENIMAGE=y
BR2_PACKAGE_HOST_MTOOLS=y
```

## buildroot-external/package/ncnn/Config.in
```kconfig
config BR2_PACKAGE_NCNN
	bool "ncnn"
	depends on BR2_INSTALL_LIBSTDCPP
	select BR2_PACKAGE_HOST_CMAKE
	help
	  CPU-only ncnn inference library for YOLO/CenterNet applications.
	  Models and application-specific post-processing are supplied separately.
```
